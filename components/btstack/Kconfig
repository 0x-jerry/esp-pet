## components/btstack/Kconfig
```kconfig
menu "BTstack Configuration"

config BTSTACK_AUDIO
    bool "I2S Audio driver"
    default n
    help
        Select this option to enable BTstack's audio driver.
        Disabled by default on ESP32-C6.

config BTSTACK_INTERNAL_BT
    bool "Support for SoC Bluetooth"
    default y if BT_CONTROLLER_ONLY
    default n
    help
        Select this option to enable the chips build in
        Bluetooth support

config BTSTACK_HCI_DUMP_STDOUT
    bool "Dump HCI traffic to stdout"
    default n
    help
        For debugging purpose this will output all received
        and send packages

menuconfig BTSTACK_EXTERNAL_UART_BT
    bool "Support for externally connected UART Bluetooth modules"
    default n
    help
        Select this option if you want to be able to connect
        to a dedicated external Bluetooth module

endmenu
```
